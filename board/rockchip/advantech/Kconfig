## board/rockchip/advantech/Kconfig
```kconfig
if TARGET_ADVANTECH_RK3399

choice
	prompt "advantech rk3399 platform select"

config PLAT_RSB3710A2_2G
	bool "Support rsb3710a2 2G"

config PLAT_RSB4710A2_2G
	bool "Support rsb4710a2 2G"

config PLAT_ROM5780A3_2G
	bool "Support rom5780a3 2G"
endchoice

config SYS_BOARD
	default "advantech"

config SYS_VENDOR
	default "rockchip"

if PLAT_RSB3710A2_2G
config SYS_CONFIG_NAME
	default "rk3399_rsb3710"

config ADV_EDP_LVDS_USE_THE_SAME_RESOURCE
	def_bool y
endif

if PLAT_RSB4710A2_2G
config SYS_CONFIG_NAME
	default "rk3399_rsb4710"

endif

if PLAT_ROM5780A3_2G
config SYS_CONFIG_NAME
	default "rk3399_rom5780"

endif

config CUSTOM_GY_SPECIFIC_OPTIONS
	bool "specific options from customer gy"
	default n

config BOARD_SPECIFIC_OPTIONS # dummy
	def_bool y

endif
```

## board/rockchip/advantech_rk3288/Kconfig
```kconfig
if TARGET_ADVANTECH_RK3288

choice
	prompt "advantech rk3288 platform select"

config PLAT_RSB4680A3_2G
	bool "Support rk3288 rsb4680a103-1 2G"

endchoice

config SYS_BOARD
	default "advantech_rk3288"

config SYS_VENDOR
	default "rockchip"

if PLAT_RSB4680A3_2G

config SYS_CONFIG_NAME
	default "rk3288_rsb4680"

endif

config BOARD_SPECIFIC_OPTIONS # dummy
	def_bool y

endif
```

## board/rockchip/rom5780/Kconfig
```kconfig
if TARGET_ROM_5780

config SYS_BOARD
	default "rom5780"

config SYS_VENDOR
	default "rockchip"

config SYS_CONFIG_NAME
	default "rom5780"

config BOARD_SPECIFIC_OPTIONS # dummy
	def_bool y

endif
```
